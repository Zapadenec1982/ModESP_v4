## sdkconfig.defaults
```kconfig
# ModESP v4 — sdkconfig defaults
# Board selection (idf.py menuconfig → ModESP Configuration)
CONFIG_MODESP_BOARD_DEV=y

# OTA rollback support
CONFIG_BOOTLOADER_APP_ROLLBACK_ENABLE=y
CONFIG_APP_ROLLBACK_ENABLE=y

# Main task stack: default 3584 too small for config JSON parsing (~4KB on stack)
CONFIG_ESP_MAIN_TASK_STACK_SIZE=8192

# Custom partition table (NVS 16K + otadata 8K + phy 4K + ota_0 1.5MB + ota_1 1.5MB + SPIFFS 960K)
CONFIG_PARTITION_TABLE_CUSTOM=y
CONFIG_PARTITION_TABLE_CUSTOM_FILENAME="partitions.csv"

# Flash size — ESP32-WROOM-32 has 4MB
CONFIG_ESPTOOLPY_FLASHSIZE_4MB=y
CONFIG_ESPTOOLPY_FLASHSIZE="4MB"

# WebSocket support in esp_http_server
CONFIG_HTTPD_WS_SUPPORT=y
```
